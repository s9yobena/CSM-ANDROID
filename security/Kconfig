## security/Kconfig
```kconfig
#
# Security configuration
#

menu "Security options"

source security/keys/Kconfig

config SECURITY_DMESG_RESTRICT
	bool "Restrict unprivileged access to the kernel syslog"
	default n
	help
	  This enforces restrictions on unprivileged users reading the kernel
	  syslog via dmesg(8).

	  If this option is not selected, no restrictions will be enforced
	  unless the dmesg_restrict sysctl is explicitly set to (1).

	  If you are unsure how to answer this question, answer N.

config SECURITY
	bool "Enable different security models"
	depends on SYSFS
	help
	  This allows you to choose different security modules to be
	  configured into your kernel.

	  If this option is not selected, the default Linux security
	  model will be used.

	  If you are unsure how to answer this question, answer N.

config SECURITYFS
	bool "Enable the securityfs filesystem"
	help
	  This will build the securityfs filesystem.  It is currently used by
	  the TPM bios character driver and IMA, an integrity provider.  It is
	  not used by SELinux or SMACK.

	  If you are unsure how to answer this question, answer N.

config SECURITY_NETWORK
	bool "Socket and Networking Security Hooks"
	depends on SECURITY
	help
	  This enables the socket and networking security hooks.
	  If enabled, a security module can use these hooks to
	  implement socket and networking access controls.
	  If you are unsure how to answer this question, answer N.

choice
	depends on SECURITY && NETLABEL
	prompt "Netlabel LSM"
	default NETLABEL_SECURITY_FIRST

	help
	  Select the security module that will send attribute
	  information in IP header options.
	  Most SELinux configurations do not take advantage
	  of Netlabel, while all Smack configurations do. Unless
	  there is a need to do otherwise chose Smack in preference
	  to SELinux.

	config NETLABEL_SECURITY_FIRST
		bool "First LSM using NetLabel"
		help
		  Send SELinux MLS information in IP packet headers

	config NETLABEL_SECURITY_SELINUX
		bool "SELinux" if SECURITY_SELINUX=y
		help
		  Send SELinux MLS information in IP packet headers

	config NETLABEL_SECURITY_SMACK
		bool "Smack" if SECURITY_SMACK=y
		help
		  Send Smack labels in IP packet headers

endchoice

config NETLABEL_LSM
	string
	default "smack" if NETLABEL_SECURITY_SMACK
	default "selinux" if NETLABEL_SECURITY_SELINUX
	default "(first)"
	help
	  The name of the LSM to use with Netlabel

config SECURITY_NETWORK_XFRM
	bool "XFRM (IPSec) Networking Security Hooks"
	depends on XFRM && SECURITY_NETWORK
	help
	  This enables the XFRM (IPSec) networking security hooks.
	  If enabled, a security module can use these hooks to
	  implement per-packet access controls based on labels
	  derived from IPSec policy.  Non-IPSec communications are
	  designated as unlabelled, and only sockets authorized
	  to communicate unlabelled data can send without using
	  IPSec.
	  If you are unsure how to answer this question, answer N.

choice
	depends on XFRM && SECURITY_NETWORK && SECURITY_NETWORK_XFRM
	prompt "XFRM LSM"
	default XFRM_SECURITY_FIRST

	help
	  Select the security module that will send attribute
	  information based on IPSec policy
	  Most SELinux configurations take advantage of XFRM.

	config XFRM_SECURITY_FIRST
		bool "First LSM using XFRM"
		help
		  Use first configured IPSec policy

	config XFRM_SECURITY_SELINUX
		bool "SELinux" if SECURITY_SELINUX=y
		help
		  Use SELinux IPSec policy

endchoice

config XFRM_LSM
	string
	default "selinux" if XFRM_SECURITY_SELINUX
	default "(first)"
	help
	  The name of the LSM to use with XFRM and IPSec policy

choice
	depends on SECURITY_NETWORK
	prompt "secmark LSM"
	default SECMARK_SECURITY_FIRST

	help
	  Select the security module that will send attribute
	  information based on secmark policy
	  Most SELinux configurations take advantage of secmark.

	config SECMARK_SECURITY_FIRST
		bool "First LSM using secmark"
		help
		  Use first configured secmark policy

	config SECMARK_SECURITY_SELINUX
		bool "SELinux" if SECURITY_SELINUX=y
		help
		  Use SELinux secmark policy

endchoice

config SECMARK_LSM
	string
	default "selinux" if SECMARK_SECURITY_SELINUX
	default "(first)"
	help
	  The name of the LSM to use with the networking secmark

choice
	depends on SECURITY && (SECURITY_SELINUX || SECURITY_SMACK)
	prompt "Peersec LSM"
	default PEERSEC_SECURITY_FIRST

	help
	  Select the security module that will send attribute
	  information in IP header options.
	  Most SELinux configurations do not take advantage
	  of Netlabel, while all Smack configurations do. Unless
	  there is a need to do otherwise chose Smack in preference
	  to SELinux.

	config PEERSEC_SECURITY_FIRST
		bool "First LSM providing for SO_PEERSEC"
		help
		  Provide the first available LSM's information with SO_PEERSEC

	config PEERSEC_SECURITY_ALL
		bool "Use lsm='value'lsm='value' format"
		help
		  Provide all available security information in SO_PEERSEC

	config PEERSEC_SECURITY_SELINUX
		bool "SELinux" if SECURITY_SELINUX=y
		help
		  Provide SELinux context with SO_PEERSEC

	config PEERSEC_SECURITY_SMACK
		bool "Smack" if SECURITY_SMACK=y
		help
		  Provide Smack labels with SO_PEERSEC

endchoice

config PEERSEC_LSM
	string
	default "smack" if PEERSEC_SECURITY_SMACK
	default "selinux" if PEERSEC_SECURITY_SELINUX
	default "(all)" if PEERSEC_SECURITY_ALL
	default "(first)"
	help
	  The name of the LSM to use with Netlabel

config SECURITY_PATH
	bool "Security hooks for pathname based access control"
	depends on SECURITY
	help
	  This enables the security hooks for pathname based access control.
	  If enabled, a security module can use these hooks to
	  implement pathname based access controls.
	  If you are unsure how to answer this question, answer N.

config INTEL_TXT
	bool "Enable Intel(R) Trusted Execution Technology (Intel(R) TXT)"
	depends on HAVE_INTEL_TXT
	help
	  This option enables support for booting the kernel with the
	  Trusted Boot (tboot) module. This will utilize
	  Intel(R) Trusted Execution Technology to perform a measured launch
	  of the kernel. If the system does not support Intel(R) TXT, this
	  will have no effect.

	  Intel TXT will provide higher assurance of system configuration and
	  initial state as well as data reset protection.  This is used to
	  create a robust initial kernel measurement and verification, which
	  helps to ensure that kernel security mechanisms are functioning
	  correctly. This level of protection requires a root of trust outside
	  of the kernel itself.

	  Intel TXT also helps solve real end user concerns about having
	  confidence that their hardware is running the VMM or kernel that
	  it was configured with, especially since they may be responsible for
	  providing such assurances to VMs and services running on it.

	  See <http://www.intel.com/technology/security/> for more information
	  about Intel(R) TXT.
	  See <http://tboot.sourceforge.net> for more information about tboot.
	  See Documentation/intel_txt.txt for a description of how to enable
	  Intel TXT support in a kernel boot.

	  If you are unsure as to whether this is required, answer N.

config LSM_MMAP_MIN_ADDR
	int "Low address space for LSM to protect from user allocation"
	depends on SECURITY && SECURITY_SELINUX
	default 32768 if ARM
	default 65536
	help
	  This is the portion of low virtual memory which should be protected
	  from userspace allocation.  Keeping a user from writing to low pages
	  can help reduce the impact of kernel NULL pointer bugs.

	  For most ia64, ppc64 and x86 users with lots of address space
	  a value of 65536 is reasonable and should cause no problems.
	  On arm and other archs it should not be higher than 32768.
	  Programs which use vm86 functionality or have some need to map
	  this low address space will need the permission specific to the
	  systems running LSM.

source security/selinux/Kconfig
source security/smack/Kconfig
source security/tomoyo/Kconfig
source security/apparmor/Kconfig
source security/yama/Kconfig

config SECURITY_LSM_MAX
	int "Maximum allowed security modules (1 to 12)"
	depends on SECURITY
	default 6
	range 1 12
	help
	  The number of security modules that can be loaded.
	  The default value allows for all of the upstream modules.
	  The maximum allowed value is 12.

config DEFAULT_SECURITY
	string "Ordered list of LSMs to register"
	depends on SECURITY
	default "(all)"
	help
	  A comma separated list of LSMs to register.
	  LSMs that are not configured that are listed
	  will be ignored. If the "security=" option is
	  specified in the boot line it will override
	  this value. If the value is "(all)" all LSMs
	  configured in the kernel will be loaded in
	  the order they request registration.

source security/integrity/Kconfig

choice
	depends on SECURITY
	prompt "Presented security module"
	default PRESENT_SECURITY_FIRST

	help
	  Select the security module that will be presented
	  with the /proc/*/attr interface.
	  If not specified the first registered LSM that uses
	  the /proc/*/attr interface will be chosen.

	config PRESENT_SECURITY_SELINUX
		bool "SELinux" if SECURITY_SELINUX=y
		help
		  Present SELinux context information in the
		  files in /proc/*/attr

	config PRESENT_SECURITY_SMACK
		bool "Simplified Mandatory Access Control" if SECURITY_SMACK=y
		help
		  Present Smack process label information
		  in /proc/*/attr/current

	config PRESENT_SECURITY_APPARMOR
		bool "AppArmor" if SECURITY_APPARMOR=y
		help
		  Present AppArmor context information in the
		  files in /proc/*/attr

	config PRESENT_SECURITY_FIRST
		bool "First LSM using /proc/.../attr"
		help
		  Present information from the first LSM that uses
		  /proc/*/attr

	config PRESENT_SECURITY_NONE
		bool "Present Nothing"
		help
		  Do not present LSM information in /proc/*/attr

endchoice

config PRESENT_SECURITY
	string
	default "selinux" if PRESENT_SECURITY_SELINUX
	default "smack" if PRESENT_SECURITY_SMACK
	default "apparmor" if PRESENT_SECURITY_APPARMOR
	default "(first)" if PRESENT_SECURITY_FIRST
	default "(none)"
	help
	  The name of the LSM to present in /proc/.../attr

endmenu
```
